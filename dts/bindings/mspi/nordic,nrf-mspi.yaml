## dts/bindings/mspi/nordic,nrf-mspi.yaml
```yaml
# Copyright (c) 2025 Nordic Semiconductor ASA
# SPDX-License-Identifier: Apache-2.0

description: Nordic MSPI Interface using SSI IP

compatible: "nordic,nrf-mspi"

include: snps,designware-ssi.yaml

properties:

  bits-per-pixel:
    type: int
    default: 0
    description: |
      When using the MSPI to drive the display, the MSPI wrapper needs to know how many bits per
      pixel (BPP) are being used. If 0, the reordering of the pixels based on the BPP is disabled.
      Valid values are 0, 4, 8 and 16.
```

## dts/bindings/mspi/nordic,nrf-qspi2-controller.yaml
```yaml
# Copyright (c) 2025 Nordic Semiconductor ASA
# SPDX-License-Identifier: Apache-2.0

description: Nordic QSPI Controller Interface using SSI IP (QSPI2)

compatible: "nordic,nrf-qspi2-controller"

include: snps,designware-ssi.yaml

properties:

  op-mode: 
    default: "MSPI_OP_MODE_CONTROLLER"
```

## dts/bindings/mspi/nordic,nrf-qspi2-device.yaml
```yaml
# Copyright (c) 2025 Nordic Semiconductor ASA
# SPDX-License-Identifier: Apache-2.0

description: Nordic QSPI Device Interface using SSI IP (QSPI2)

compatible: "nordic,nrf-qspi2-device"

include: snps,designware-ssi-device.yaml
```

## dts/bindings/mspi/nordic,nrf-qspi2.yaml
```yaml
# Copyright (c) 2025 Nordic Semiconductor ASA
# SPDX-License-Identifier: Apache-2.0

description: Nordic QSPI Interface using SSI IP (QSPI2)

compatible: "nordic,nrf-qspi2"

include: snps,designware-ssi-controller.yaml
```

## dts/bindings/mspi/snps,designware-ssi-controller.yaml
```yaml
# Copyright (c) 2025 Nordic Semiconductor ASA
# SPDX-License-Identifier: Apache-2.0

description: Synopsys DesignWare Synchronous Serial Interface (SSI) controller node

compatible: "snps,designware-ssi-controller"

include: ["snps,designware-ssi.yaml", mspi-controller.yaml, pinctrl-device.yaml]

properties:

  op-mode: "MSPI_OP_MODE_CONTROLLER"
```

## dts/bindings/mspi/snps,designware-ssi-device.yaml
```yaml
# Copyright (c) 2025 Nordic Semiconductor ASA
# SPDX-License-Identifier: Apache-2.0

description: Synopsys DesignWare Synchronous Serial Interface (SSI) device node

compatible: "snps,designware-ssi-device"

include: ["snps,designware-ssi.yaml", mspi-device.yaml, pinctrl-device.yaml]

properties:

  op-mode: "MSPI_PERIPHERAL"
```

## dts/bindings/mspi/zephyr,mspi-peripheral-device.yaml
```yaml
# Copyright (c) 2026 Nordic Semiconductor ASA
# SPDX-License-Identifier: Apache-2.0

description: |
  Generic MSPI peripheral device. This node describes a device on the MSPI bus
  that is a peripheral (e.g. another SoC in peripheral mode, or an external peripheral).
  The local MSPI controller is the master; this node describes the peripheral
  it talks to. Use for SoC-to-SoC links, or any application-defined peripheral with no
  dedicated Zephyr driver.

compatible: "zephyr,mspi-peripheral-device"

include: mspi-device.yaml
```
